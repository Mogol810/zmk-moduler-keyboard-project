/ {
    matrix {
        compatible = "zmk,matrix";
        diode-direction = "col2row";
        rows = <&row0 &row1>;
        cols = <&col0 &col1>;
    };
};

&aliases {
    row0 = &gpio1_12;
    row1 = &gpio1_13;
    col0 = &gpio0_5;
    col1 = &gpio1_11;
};
